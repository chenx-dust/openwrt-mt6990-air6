## configs/softbank_air6.defconfig
```kconfig
CONFIG_TARGET_mediatek=y
CONFIG_TARGET_mediatek_mt6990=y
CONFIG_TARGET_mediatek_mt6990_DEVICE_softbank_air6=y
CONFIG_TARGET_SQUASHFS_BLOCK_SIZE=256
CONFIG_USE_APK=y
CONFIG_PACKAGE_kmod-mt7996e=y
CONFIG_PACKAGE_kmod-mt7990-firmware=y
CONFIG_PACKAGE_kmod-mt6990-hwnat=y
CONFIG_PACKAGE_lg6851f-modem-chain-only=y
CONFIG_PACKAGE_luci=y
CONFIG_PACKAGE_luci-app-5gmodem=y
CONFIG_PACKAGE_luci-i18n-base-zh-cn=y
CONFIG_PACKAGE_luci-i18n-5gmodem-zh-cn=y
CONFIG_PACKAGE_luci-i18n-firewall-zh-cn=y
CONFIG_PACKAGE_luci-i18n-package-manager-zh-cn=y
CONFIG_PACKAGE_wpad-basic-mbedtls=y
CONFIG_PACKAGE_iw=y
CONFIG_PACKAGE_wireless-regdb=y
CONFIG_PACKAGE_block-mount=y
CONFIG_PACKAGE_fitblk=y
CONFIG_PACKAGE_libf2fs=y
CONFIG_PACKAGE_mkf2fs=y
CONFIG_PACKAGE_f2fsck=y
```
